## boards/shields/rs69lp/Kconfig.defconfig
```kconfig
if SHIELD_RS69LP_LEFT

config ZMK_KEYBOARD_NAME
    default "RS69-LP"

config ZMK_SPLIT_ROLE_CENTRAL
    default y

endif # SHIELD_RS69LP_LEFT

if SHIELD_RS69LP_LEFT || SHIELD_RS69LP_RIGHT

config ZMK_SPLIT
    default y

endif # SHIELD_RS69LP_LEFT || SHIELD_RS69LP_RIGHT
```

## boards/shields/rs69lp/Kconfig.shield
```kconfig
config SHIELD_RS69LP_LEFT
    def_bool $(shields_list_contains,rs69lp_left)

config SHIELD_RS69LP_RIGHT
    def_bool $(shields_list_contains,rs69lp_right)
```
